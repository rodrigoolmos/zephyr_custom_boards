&clk_hse {
	clock-frequency = <DT_FREQ_M(25)>; /* STLink 8MHz clock */
	status = "okay";
};

&clk_lse {
	status = "okay";
};

&pll {
	div-m = <2>;
	mul-n = <44>;
	div-p = <1>;
	div-q = <2>;
	div-r = <2>;
	clocks = <&clk_hse>;
	status = "okay";
};

&rcc {
	clocks = <&pll>;
	clock-frequency = <DT_FREQ_M(550)>;
	d1cpre = <1>;
	hpre = <2>;    /* HCLK: 275   MHz */
	d1ppre = <2>;  /* APB1: 137.5 MHz */
	d2ppre1 = <2>; /* APB2: 137.5 MHz */
	d2ppre2 = <2>; /* APB3: 137.5 MHz */
	d3ppre = <2>;  /* APB4: 137.5 MHz */
};
/*
this overlay modify the clock configuration cording to the ckock oscilator for this specific board

*/